## conf/distro/cip-core-bookworm.conf
```bitbake
#
# CIP Core, generic profile
#
# Copyright (c) Siemens AG, 2023-2024
#
# Authors:
#  Quirin Gylstorff <quirin.gylstorff@siemens.com>
#
# SPDX-License-Identifier: MIT
#

require conf/distro/debian-bookworm.conf
require cip-core-common.inc

PREFERRED_VERSION_swupdate ?= "2023.12%"
PREFERRED_VERSION_linux-cip ?= "6.1.%"
PREFERRED_VERSION_linux-cip-native ?= "6.1.%"
PREFERRED_VERSION_linux-cip-kbuildtarget ?= "6.1.%"
PREFERRED_VERSION_linux-cip-rt ?= "6.1.%"
PREFERRED_VERSION_linux-cip-rt-native ?= "6.1.%"
PREFERRED_VERSION_linux-cip-rt-kbuildtarget ?= "6.1.%"
```

## conf/distro/cip-core-bullseye.conf
```bitbake
#
# CIP Core, generic profile
#
# Copyright (c) Siemens AG, 2021-2022
#
# Authors:
#  Jan Kiszka <jan.kiszka@siemens.com>
#
# SPDX-License-Identifier: MIT
#

require conf/distro/debian-bullseye.conf
require cip-core-common.inc

DISTRO_APT_SOURCES:append:swupdate = " conf/distro/debian-bullseye-backports.list"
DISTRO_APT_PREFERENCES:append:swupdate = " conf/distro/preferences.swupdate-bullseye-backports.conf"

PREFERRED_VERSION_swupdate ?= "2022.12%"
PREFERRED_VERSION_linux-cip ?= "5.10.%"
PREFERRED_VERSION_linux-cip-rt ?= "5.10.%"
```

## conf/distro/cip-core-common.inc
```bitbake
#
# CIP Core, generic profile
#
# Copyright (c) Siemens AG, 2019-2023
#
# Authors:
#  Jan Kiszka <jan.kiszka@siemens.com>
#
# SPDX-License-Identifier: MIT
#

KERNEL_NAME ?= "cip"

WKS_FILE ?= "${MACHINE}.wks"

CIP_IMAGE_OPTIONS ?= ""

IMAGER_BUILD_DEPS:append = " dosfstools-native"
IMAGER_BUILD_DEPS:remove:buster = "dosfstools-native"

PREFERRED_VERSION_linux-cip-native ?= "${PREFERRED_VERSION_linux-cip}"
PREFERRED_VERSION_linux-cip-kbuildtarget ?= "${PREFERRED_VERSION_linux-cip}"

PREFERRED_VERSION_linux-cip-rt-native ?= "${PREFERRED_VERSION_linux-cip-rt}"
PREFERRED_VERSION_linux-cip-rt-kbuildtarget ?= "${PREFERRED_VERSION_linux-cip-rt}"
```

## conf/distro/cip-core-sid-ports.conf
```bitbake
#
# CIP Core, generic profile
#
# Copyright (c) Siemens AG, 2022-2023
#
# Authors:
#  Jan Kiszka <jan.kiszka@siemens.com>
#
# SPDX-License-Identifier: MIT
#

require conf/distro/debian-sid-ports.conf
require cip-core-common.inc

PREFERRED_VERSION_linux-cip ?= "5.10.%"
PREFERRED_VERSION_linux-cip-rt ?= "5.10.%"
PREFERRED_VERSION_swupdate ?= "2023.05%"

DISTRO_APT_SOURCES = "conf/distro/cip-debian-sid-ports-snapshot.list"
HOST_DISTRO_APT_SOURCES = "conf/distro/cip-debian-sid-snapshot.list ${DISTRO_APT_SOURCES}"
```

## conf/distro/cip-core-sid.conf
```bitbake
#
# CIP Core, generic profile
#
# Copyright (c) Siemens AG, 2022-2024
#
# Authors:
#  Jan Kiszka <jan.kiszka@siemens.com>
#
# SPDX-License-Identifier: MIT
#

require conf/distro/debian-sid.conf
require cip-core-common.inc

# corresponds to 20240211T000000Z
ISAR_APT_SNAPSHOT_TIMESTAMP ?= "1707606000"
ISAR_USE_APT_SNAPSHOT ?= "1"

PREFERRED_VERSION_linux-cip ?= "6.1.%"
PREFERRED_VERSION_linux-cip-rt ?= "6.1.%"
```

## conf/distro/cip-core-trixie.conf
```bitbake
#
# CIP Core, generic profile
#
# Copyright (c) Siemens AG, 2024-2025
#
# Authors:
#  Cedric Hombourger <cedric.hombourger@siemens.com>
#
# SPDX-License-Identifier: MIT
#

require conf/distro/debian-trixie.conf
require cip-core-common.inc

PREFERRED_VERSION_linux-cip ?= "6.12.%"
PREFERRED_VERSION_linux-cip-rt ?= "6.12.%"

# cross build currently broken, use working snapshot
ISAR_USE_APT_SNAPSHOT = "1"
ISAR_APT_SNAPSHOT_DATE = "20250309T000000Z"
```

## conf/machine/bbb.conf
```bitbake
#
# CIP Core, generic profile
#
# Copyright (c) Siemens AG, 2019
#
# SPDX-License-Identifier: MIT
#

DISTRO_ARCH = "armhf"

IMAGE_FSTYPES ?= "ext4-img"

PREFERRED_PROVIDER_u-boot-${MACHINE} = "u-boot-bbb"
PREFERRED_PROVIDER_u-boot-tools = "u-boot-bbb"

DTB_FILES = "am335x-boneblack.dtb"

IMAGE_BOOT_FILES = " \
    /usr/lib/u-boot/bbb/u-boot.img;u-boot.img \
    /usr/lib/u-boot/bbb/MLO;MLO \
    ${DEPLOY_DIR_IMAGE}/boot.scr;boot.scr \
    ${DEPLOY_DIR_IMAGE}/uboot.env;uboot.env \
    ${DEPLOY_DIR_IMAGE}/${DTB_FILES};${DTB_FILES} \
    ${DEPLOY_DIR_IMAGE}/${KERNEL_IMAGE};vmlinuz \
    ${DEPLOY_DIR_IMAGE}/${INITRD_IMAGE};initrd"

IMAGE_INSTALL += "u-boot-script"

IMAGER_INSTALL += "u-boot-bbb"
IMAGER_BUILD_DEPS += "u-boot-bbb"

# Currently supported bootloader bindings for SWUpdate are 'u-boot' and 'efibootguard'.
SWUPDATE_BOOTLOADER = "u-boot"
```

## conf/machine/qemu-amd64.conf
```bitbake
#
# CIP Core, generic profile
#
# Copyright (c) Siemens AG, 2019-2025
#
# SPDX-License-Identifier: MIT
#

DISTRO_ARCH = "amd64"

IMAGE_FSTYPES ?= "ext4"
USE_CIP_KERNEL_CONFIG = "1"
KERNEL_DEFCONFIG = "cip-kernel-config/${KERNEL_DEFCONFIG_VERSION}/x86/cip_merged_defconfig"

IMAGER_INSTALL:wic += "btrfs-progs"
VAR_FS_TYPE = "btrfs"
```

## conf/machine/qemu-riscv64.conf
```bitbake
#
# CIP Core, generic profile
#
# Copyright (c) Siemens AG, 2022
#
# Authors:
#  Jan Kiszka <jan.kiszka@siemens.com>
#
# SPDX-License-Identifier: MIT
#

DISTRO_ARCH = "riscv64"

IMAGE_FSTYPES ?= "ext4"
USE_CIP_KERNEL_CONFIG = "1"

KERNEL_DEFCONFIG ?= "cip-kernel-config/${KERNEL_DEFCONFIG_VERSION}/riscv/qemu_riscv64_defconfig"

# watchdog is not yet supported in our QEMU executor for this platform, disable it
WDOG_TIMEOUT = "0"

PREFERRED_PROVIDER_u-boot-${MACHINE} = "u-boot-qemu-riscv64"
```

## conf/machine/rzfive.conf
```bitbake
#
# CIP Core, generic profile
#
# Copyright (c) Siemens AG, 2022
#
# SPDX-License-Identifier: MIT
#

DISTRO_ARCH = "riscv64"

KERNEL_NAME = "rzfive"
DTB_FILES = "renesas/r9a07g043f01-smarc.dtb"

IMAGE_FSTYPES ?= "wic"
```

## conf/machine/zynqmp-zcu102.conf
```bitbake
#
# CIP Core, generic profile
#
# Copyright (c) Cybertrust Japan Co., Ltd. 2025
#
# SPDX-License-Identifier: MIT
#
DISTRO_ARCH = "arm64"
```

## recipes-core/swupdate/files/swupdate_defconfig
```kconfig
CONFIG_HAVE_DOT_CONFIG=y
CONFIG_SYSTEMD=y
CONFIG_SCRIPTS=y
CONFIG_SW_VERSIONS_FILE="/etc/sw-versions"
CONFIG_SOCKET_CTRL_PATH="/tmp/sockinstctrl"
CONFIG_SOCKET_PROGRESS_PATH="/tmp/swupdateprog"
CONFIG_SOCKET_REMOTE_HANDLER_DIRECTORY="/tmp/"
CONFIG_LUA=y
CONFIG_LUAPKG="lua53"
CONFIG_CROSS_COMPILE=""
CONFIG_SYSROOT=""
CONFIG_EXTRA_CFLAGS="-isystem /usr/include/lua5.3"
CONFIG_EXTRA_LDFLAGS=""
CONFIG_EXTRA_LDLIBS="lua5.3"
CONFIG_GUNZIP=y
CONFIG_LIBCONFIG=y
CONFIG_PARSERROOT=""
CONFIG_RAW=y
CONFIG_RDIFFHANDLER=y
CONFIG_LUASCRIPTHANDLER=y
CONFIG_HANDLER_IN_LUA=y
CONFIG_EMBEDDED_LUA_HANDLER=y
CONFIG_EMBEDDED_LUA_HANDLER_SOURCE="swupdate_handlers.lua"
CONFIG_ARCHIVE=y
CONFIG_BOOTLOADERHANDLER=y
CONFIG_MTD=n
```

## wic/bbb.wks
```
#
# CIP Core, generic profile
#
# Copyright (c) Siemens AG, 2019
#
# SPDX-License-Identifier: MIT
#

part --source rawcopy --sourceparams "file=/usr/lib/u-boot/bbb/MLO" --no-table --align 128
part --source rawcopy --sourceparams "file=/usr/lib/u-boot/bbb/u-boot.img" --no-table --align 384

part / --source rootfs-u-boot --ondisk mmcblk0 --fstype ext4 --mkfs-extraopts "-T default" --label platform --align 1024 --active --fsuuid 1f55d66a-40d8-11ee-be56-0242ac120002 --uuid 25d57b24-f34d-412e-8c88-28629f23aa0d

bootloader --append "rootwait console=ttyO0,115200"
```

## wic/hihope-rzg2m.wks
```
#
# CIP Core, generic profile
#
# Copyright (c) Siemens AG, 2019
#
# Authors:
#  Quirin Gylstorff <quirin.gylstorff@siemens.com>
#
# SPDX-License-Identifier: MIT
#

part /boot --source bootimg-partition --ondisk mmcblk0 --fstype vfat --label boot --align 1 --size 32M --extra-space 0 --fsuuid 0x4321dcba --uuid d122d639-1d92-4b41-bf7b-4b2bdf8dd899

# Rootfs partition
part / --source rootfs --ondisk mmcblk0 --fstype ext4 --label root --align 1024 --size 2G --active --fsuuid 1f55d66a-40d8-11ee-be56-0242ac120002 --uuid b8bbba3f-3ba6-4b2b-8d69-4a95fd4f34ed
```

## wic/iwg20m.wks
```
#
# CIP Core, generic profile
#
# Copyright (c) Toshiba corp., 2019
#
# Authors:
#  Daniel Sangorrin <daniel.sangorrin@toshiba.co.jp>
#
# SPDX-License-Identifier: MIT
#

# [Note] u-boot runs from an SPI memory device

# SDCard Boot partition (copies files in IMAGE_BOOT_FILES: zImage and device tree)
part /boot --source bootimg-partition --ondisk mmcblk0 --fstype vfat --label boot --align 1 --size 32M --extra-space 0 --fsuuid 0x4321dcba --uuid 28a58348-5270-44d3-bea4-b1c492a81b7f

# Rootfs partition
part / --source rootfs --ondisk mmcblk0 --fstype ext4 --label root --align 1024 --size 2G --active --fsuuid 1f55d66a-40d8-11ee-be56-0242ac120002 --uuid d0fa8361-7deb-43df-acee-1725d40d403e
```

## wic/rzfive.wks
```
#
# CIP Core, generic profile
#
# Copyright (c) Siemens AG, 2022
#
# SPDX-License-Identifier: MIT
#

part / --source rootfs --fstype ext4 --mkfs-extraopts "-T default" --label platform --align 1024 --active

bootloader --append "rootwait"
```

## wic/x86_64-generic.wks
```
#
# CIP Core, generic profile
#
# Copyright (c) Siemens AG, 2019
#
# SPDX-License-Identifier: MIT
#

part /boot --source bootimg-efi-isar --sourceparams "loader=grub-efi" --label efi --part-type EF00 --align 1024 --fsuuid 0x4321dcba --uuid cf142945-6fa1-4945-b0f2-b8d6226298c0

part / --source rootfs --fstype ext4 --mkfs-extraopts "-T default" --label platform --align 1024 --fsuuid 1f55d66a-40d8-11ee-be56-0242ac120002 --uuid f225331b-2d9c-45a2-bcfe-4a6e86287dfb

bootloader --ptable gpt --timeout 2 --append "console=ttyS0,115200"
```
